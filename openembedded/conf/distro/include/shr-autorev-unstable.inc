## openembedded/conf/distro/include/shr-autorev-unstable.inc
```bitbake
# PREFERRED_PROVIDER_frameworkd = "frameworkd-devel"

# libeflvala needs at least 2.18.0 and upstream OE provides only 2.16.4
PREFERRED_VERSION_glib-2.0 = "2.18.3"

# FSO stuff
SRCREV_pn-frameworkd = "${AUTOREV}"
SRCREV_pn-frameworkd-config-shr = "${AUTOREV}"
SRCREV_pn-libeflvala = "4b7440b08b96831da5cc2ef657af76ae20f3065a"
SRCREV_pn-frameworkd-config-shr = "${AUTOREV}"
SRCREV_pn-frameworkd-config-shr_FSO_REV = "${AUTOREV}"
SRCREV_pn-frameworkd-config-shr_SHR_REV = "${AUTOREV}"
SRCREV_pn-vala-terminal = "2f849c5690d8"
SRCREV_pn-vala-dbus-binding-tool = "${AUTOREV}"
SRCREV_pn-libfso-glib = "${AUTOREV}"

# SHR stuff
SRCREV_pn-shr-settings = "${AUTOREV}"
SRCREV_pn-shr-theme = "${AUTOREV}"
SRCREV_pn-libframeworkd-glib = "${AUTOREV}"
SRCREV_pn-ophonekitd = "${AUTOREV}"
SRCREV_pn-shr-messages = "${AUTOREV}"
SRCREV_pn-shr-contacts = "${AUTOREV}"
SRCREV_pn-shr-dialer = "${AUTOREV}"
SRCREV_pn-libframeworkd-phonegui-efl = "${AUTOREV}"
SRCREV_pn-libframeworkd-phonegui-efl2 = "${AUTOREV}"
SRCREV_pn-libframeworkd-phonegui = "${AUTOREV}"
SRCREV_pn-libhito = "${AUTOREV}"
SRCREV_pn-neod = "${AUTOREV}"
SRCREV_pn-libframeworkd-phonegui-gtk = "${AUTOREV}"
PREFERRED_VERSION_calc = "0.0.1"
#pin shr-config due to gnome bug 579803 (requires vala > 0.7.1)
SRCREV_pn-shr-config = "9b59390d265805b68ea10136fa03fa67713f1275"

EFL_SRCREV = "39827"
SRCREV_pn-python-elementary = "39834"

# KERNEL
SRCREV_pn-linux-openmoko-2.6.28 = "${AUTOREV}"
SRCREV_pn-linux-eten = "df9715883efa3e6a88866813168fabb1c16b0b7a"

# other stuff
SRCREV_pn-openmoocow = "${AUTOREV}"
SRCREV_pn-libmokoui2 = "4695"

#PREFERRED_VERSION_fakeroot = "1.12.1"
#PREFERRED_VERSION_fakeroot-native = "1.12.1"

SRCREV_pn-boost-signals2 = "52299"
SRCREV_pn-dbus-c++-native = "${AUTOREV}"
SRCREV_pn-dbus-c++ = "${AUTOREV}"
```

## openembedded/conf/distro/include/shr-autorev.inc
```bitbake
DISTRO_INITSCRIPTS = "initscripts-shr"
DISTRO_DEV_MANAGER = "udev"

#KERNEL
SRCREV_pn-linux-eten = "df9715883efa3e6a88866813168fabb1c16b0b7a"
SRCREV_pn-linux-openmoko-2.6.28 = "2bea5c68313577b214b872b0edc5968db0cf3b68"

PREFERRED_PROVIDER_frameworkd-config = "frameworkd-config-shr"
PREFERRED_PROVIDER_frameworkd = "frameworkd"
PREFERRED_PROVIDER_gpsd = "fso-gpsd"
PREFERRED_PROVIDER_e-wm-menu = "e-wm-menu"

PREFERRED_VERSION_shared-mime-info = "0.51"
PREFERRED_VERSION_navit = "0.1.0+svnrev${SRCREV}"
PREFERRED_VERSION_libosip2 = "2.2.2"
PREFERRED_VERSION_udev = "124"
PREFERRED_VERSION_midori = "0.1.2"
PREFERRED_VERSION_obexftp = "0.22"
PREFERRED_VERSION_glib-2.0 = "2.18.3"


#FSO stuff
SRCREV_pn-frameworkd = "516f48762ab7afa4e4702a0ba01bc0a004ae4c60"
SRCREV_pn-frameworkd-config-shr = "af17066e4277efb190585c6d41a471b607371bd1"
SRCREV_pn-fso-gpsd = "78fe48dffb923175bde9f0aabc3500a9264a57e0"
SRCREV_pn-fso-sounds = "831b1b0bc0276623bbde881ae974c2df2e2de8ea"
SRCREV_pn-gsm0710muxd = "abcbcd7cc532a8834906de3fc24c8f8fe7643cd4"
SRCREV_pn-gsmd2 = "6d30f165052e77c3eb9b35f3d29a040558e4d07f"
SRCREV_pn-illume-theme-freesmartphone = "831b1b0bc0276623bbde881ae974c2df2e2de8ea"
SRCREV_pn-mickeydbus = "6156550b00d04b6ff3e41e8d3ba4ef0edd90e77b"
SRCREV_pn-mickeyterm = "6156550b00d04b6ff3e41e8d3ba4ef0edd90e77b"
SRCREV_pn-python-pytrc = "${AUTOREV}"
SRCREV_pn-zhone = "72d00e7bc606e83d4e18e0d7d88a08d88978f5a4"

#SHR stuff
SRCREV_pn-libhito = "ef0b5f4ffd2da738ea2265b5635cc5f51ff95779"
SRCREV_pn-neod = "ef0b5f4ffd2da738ea2265b5635cc5f51ff95779"
SRCREV_pn-shr-settings = "a3e5e3430cf3803e21107e8e83aefdbcab27f56a"
SRCREV_pn-shr-theme = "ef0b5f4ffd2da738ea2265b5635cc5f51ff95779"
SRCREV_pn-libframeworkd-glib = "9765f6989d09d8f9b8676e1ef7e2501fe67fbdbc"
SRCREV_pn-ophonekitd = "ef0b5f4ffd2da738ea2265b5635cc5f51ff95779"
SRCREV_pn-openmoko-messages3 = "ef0b5f4ffd2da738ea2265b5635cc5f51ff95779"
SRCREV_pn-openmoko-contacts3 = "ef0b5f4ffd2da738ea2265b5635cc5f51ff95779"
SRCREV_pn-openmoko-dialer3 = "ef0b5f4ffd2da738ea2265b5635cc5f51ff95779"
SRCREV_pn-libframeworkd-phonegui-efl = "ef0b5f4ffd2da738ea2265b5635cc5f51ff95779"
SRCREV_pn-libframeworkd-phonegui = "ef0b5f4ffd2da738ea2265b5635cc5f51ff95779"
SRCREV_pn-libframeworkd-phonegui-gtk = "ef0b5f4ffd2da738ea2265b5635cc5f51ff95779"
SRCREV_pn-pyphonelog = "e2370f7398edd"
SRCREV_pn-shr-theme-brave = "${AUTOREV}"

#General stuff
EFL_SRCREV = "39827"

SRCREV_pn-navit      = "2198"
SRCREV_pn-python-elementary = "39834"
SRCREV_pn-omview     = "34"
SRCREV_pn-pythm      = "19"
SRCREV_pn-omoney     = "29"
SRCREV_pn-enotes     = "19"
SRCREV_pn-ebrainy    = "21"
SRCREV_pn-boost-signals2 = "52299"
SRCREV_pn-dbus-c++-native = "${AUTOREV}"
SRCREV_pn-dbus-c++ = "${AUTOREV}"
SRCREV_pn-openmoocow = "d2c3c9eb"
SRCREV_pn-libmokoui2 = "4695"
SRCREV_pn-calc       = "3d527c9d"
SRCREV_pn-shr-config = "9b59390d"
SRCREV_pn-libeflvala = "676c901e"
```
